## boot/uboot/u-boot-2020.04/arch/arm/mach-axera/Kconfig
```kconfig
if ARCH_AXERA

config AXERA_AX650
	bool "Support AXERA AX650"
	select ARM64
	help
	  The AXERA AX630X is a ARM-based SoC with quad-core Cortex-A53.
	  including NEON and GPU, 512KB L2 cache, two video interfaces supporting
	  HDMI, several LPDDR4 options and video codec support. Peripherals include
	  Gigabit Ethernet, USB2 host and OTG, SDIO, I2S, UARTs, SPI, I2C and PWMs.
	select OF_CONTROL
	select SUPPORT_SPL

config SYS_VENDOR
        default "axera"

config SYS_SOC
        default "axera"

source "arch/arm/mach-axera/ax650/Kconfig"

endif
```

## boot/uboot/u-boot-2020.04/arch/arm/mach-axera/ax650/Kconfig
```kconfig
if ARCH_AXERA

config TARGET_AX650_HAPS
	bool "AX650_HAPS evaluation board"
	help
	  AX650_haps is a evaluation board for AXERA AX650,
	  with full function and phisical connectors support like
	  usb2.0 host ports, JTAG, MAC, SDcard, HDMI, USB-2-serial...

config TARGET_AX650_EMMC
	bool "AX650_EMMC evaluation board"
	help
	  AX650_emmc is a evaluation board for AXERA AX650,
	  with full function and phisical connectors support like
	  usb2.0 host ports, JTAG, MAC, SDcard, HDMI, USB-2-serial...
config TARGET_AX650_SSD
	bool "AX650_SSD evaluation board"
	help
	  AX650_emmc is a evaluation board for AXERA AX650,
	  with full function and phisical connectors support like
	  usb2.0 host ports, JTAG, MAC, SDcard, HDMI, USB-2-serial...
config TARGET_AX650_XPILOT_6V
	bool "AX650_XPILOT_6V board"
	help
	  AX650_xpilot_6v is a evaluation board for AXERA AX650,
	  with full function and phisical connectors support like
	  usb2.0 host ports, JTAG, MAC, SDcard, HDMI, USB-2-serial...
config TARGET_AX650_PIPRO_BOX
	bool "AX650_PIPRO_BOX evaluation board"
	help
	  AX650_emmc is a evaluation board for AXERA AX650,
	  with full function and phisical connectors support like
	  usb2.0 host ports, JTAG, MAC, SDcard, HDMI, USB-2-serial...
config TARGET_AX650_SSD
	bool "AX650_SSD evaluation board"
	help
	  AX650_emmc is a evaluation board for AXERA AX650,
	  with full function and phisical connectors support like
	  usb2.0 host ports, JTAG, MAC, SDcard, HDMI, USB-2-serial...
config TARGET_AX650_XPILOT_6V
	bool "AX650_XPILOT_6V board"
	help
	  AX650_xpilot_6v is a evaluation board for AXERA AX650,
	  with full function and phisical connectors support like
	  usb2.0 host ports, JTAG, MAC, SDcard, HDMI, USB-2-serial...
config TARGET_AX650_LP
	bool "AX650_LP evaluation board"
	help
	  AX650_LP is a evaluation board for AXERA AX650,
	  with full function and phisical connectors support like
	  usb2.0 host ports, JTAG, MAC, SDcard, HDMI, USB-2-serial...

config TARGET_AX650_CARD
	bool "AX650_CARD evaluation board"
	help
	  AX650_card is a evaluation board for AXERA AX650,
	  with full function and phisical connectors support like
	  usb2.0 host ports, JTAG, MAC, SDcard, HDMI, USB-2-serial...

config TARGET_AX650_MASTER
	bool "AX650_MASTER evaluation board"
	help
	  AX650_master is a evaluation board for AXERA AX650,
	  with full function and phisical connectors support like
	  usb2.0 host ports, JTAG, MAC, SDcard, HDMI, USB-2-serial...

config TARGET_AX650_SLAVE
	bool "AX650_SLAVE evaluation board"
	help
	  AX650_slave is a evaluation board for AXERA AX650,
	  with full function and phisical connectors support like
	  usb2.0 host ports, JTAG, MAC, SDcard, HDMI, USB-2-serial...

config TARGET_AX650_NAND
	bool "AX650_NAND evaluation board"
	help
	  AX650_nand is a evaluation board for AXERA AX650,
	  with full function and phisical connectors support like
	  usb2.0 host ports, JTAG, MAC, SDcard, HDMI, USB-2-serial...

config AXERA_MEMORY_DUMP_EMMC
	bool "axera memory dump to emmc"
	depends on TARGET_AX650_EMMC || TARGET_AX650_MASTER
	help
	  save dump file to emmc

config AXERA_MEMORY_DUMP_SD
	bool "axera memory dump to sd card"
	depends on TARGET_AX650_EMMC || TARGET_AX650_MASTER
	help
	  save dump file to sd card

config AXERA_MEMORY_DUMP_USB_STORAGE
	bool "axera memory dump to usb storage"
	depends on TARGET_AX650_EMMC || TARGET_AX650_NAND
	help
	  save dump file to usb storage

config AXERA_MEMORY_DUMP_PCIE
	bool "axera memory dump use pcie ep"
	depends on SLAVE_PCIE_BOOT
	help
	  use the pcie interface to obtain the dump file

config AXERA_MEMORY_DUMP_SSD
	bool "axera memory dump use ssd"
	depends on TARGET_AX650_SSD
	help
	 use the pcie ssd save dump file

config AXERA_MEMORY_FIREWALL
	bool "axera memory firewall"
	help
	  use the memory firewall for memory access protect

config AXERA_SUPPORT_AB_OTA
	bool "Support A/B OTA"
	def_bool n
	help
	  Support A/B OTA

source "board/axera/ax650_emmc/Kconfig"
source "board/axera/ax650_xpilot_6v/Kconfig"
source "board/axera/ax650_nand/Kconfig"
source "board/axera/ax650_slave/Kconfig"
source "board/axera/ax650_master/Kconfig"
source "board/axera/ax650_ssd/Kconfig"
source "board/axera/ax650_pipro_box/Kconfig"
source "board/axera/ax650_lp/Kconfig"
source "board/axera/ax650_card/Kconfig"


endif
```

## boot/uboot/u-boot-2020.04/board/axera/ax650_card/Kconfig
```kconfig
if TARGET_AX650_CARD

config SYS_BOARD
	default "ax650_card"

config SYS_VENDOR
	default "axera"

config SYS_CONFIG_NAME
	default "ax650_card"

config BOARD_SPECIFIC_OPTIONS # dummy
	def_bool y

config BOOT_OPTIMIZATION
	def_bool y
	help
	  Enable boot optimization.
	  1. New Image and dtb image format.

endif
```

## boot/uboot/u-boot-2020.04/board/axera/ax650_emmc/Kconfig
```kconfig
if TARGET_AX650_EMMC

config SYS_BOARD
	default "ax650_emmc"

config SYS_VENDOR
	default "axera"

config SYS_CONFIG_NAME
	default "ax650_emmc"

config BOARD_SPECIFIC_OPTIONS # dummy
	def_bool y

config BOOT_OPTIMIZATION
	def_bool y
	help
	  Enable boot optimization.
	  1. New Image and dtb image format.

endif
```

## boot/uboot/u-boot-2020.04/board/axera/ax650_lp/Kconfig
```kconfig
if TARGET_AX650_LP

config SYS_BOARD
	default "ax650_lp"

config SYS_VENDOR
	default "axera"

config SYS_CONFIG_NAME
	default "ax650_lp"

config BOARD_SPECIFIC_OPTIONS # dummy
	def_bool y

config BOOT_OPTIMIZATION
	def_bool y
	help
	  Enable boot optimization.
	  1. New Image and dtb image format.

endif
```

## boot/uboot/u-boot-2020.04/board/axera/ax650_nand/Kconfig
```kconfig
if TARGET_AX650_NAND

config SYS_BOARD
	default "ax650_nand"

config SYS_VENDOR
	default "axera"

config SYS_CONFIG_NAME
	default "ax650_nand"

config BOARD_SPECIFIC_OPTIONS # dummy
	def_bool y

config BOOT_OPTIMIZATION
	def_bool y
	help
	  Enable boot optimization.
	  1. New Image and dtb image format.

endif
```

## boot/uboot/u-boot-2020.04/board/axera/ax650_pipro_box/Kconfig
```kconfig
if TARGET_AX650_PIPRO_BOX

config SYS_BOARD
	default "ax650_pipro_box"

config SYS_VENDOR
	default "axera"

config SYS_CONFIG_NAME
	default "ax650_pipro_box"

config BOARD_SPECIFIC_OPTIONS # dummy
	def_bool y

config BOOT_OPTIMIZATION
	def_bool y
	help
	  Enable boot optimization.
	  1. New Image and dtb image format.

endif
```

## boot/uboot/u-boot-2020.04/board/axera/ax650_slave/Kconfig
```kconfig
if TARGET_AX650_SLAVE

config SYS_BOARD
	default "ax650_slave"

config SYS_VENDOR
	default "axera"

config SYS_CONFIG_NAME
	default "ax650_slave"

config BOARD_SPECIFIC_OPTIONS # dummy
	def_bool y

config BOOT_OPTIMIZATION
	def_bool y
	help
	  Enable boot optimization.
	  1. New Image and dtb image format.

endif
```

## boot/uboot/u-boot-2020.04/board/axera/ax650_ssd/Kconfig
```kconfig
if TARGET_AX650_SSD

config SYS_BOARD
	default "ax650_ssd"

config SYS_VENDOR
	default "axera"

config SYS_CONFIG_NAME
	default "ax650_ssd"

config BOARD_SPECIFIC_OPTIONS # dummy
	def_bool y

config BOOT_OPTIMIZATION
	def_bool y
	help
	  Enable boot optimization.
	  1. New Image and dtb image format.

endif
```

## boot/uboot/u-boot-2020.04/board/axera/ax650_xpilot_6v/Kconfig
```kconfig
if TARGET_AX650_XPILOT_6V

config SYS_BOARD
	default "ax650_xpilot_6v"

config SYS_VENDOR
	default "axera"

config SYS_CONFIG_NAME
	default "ax650_xpilot_6v"

config BOARD_SPECIFIC_OPTIONS # dummy
	def_bool y

config BOOT_OPTIMIZATION
	def_bool y
	help
	  Enable boot optimization.
	  1. New Image and dtb image format.

endif
```

## boot/uboot/u-boot-2020.04/configs/AX650_emmc_defconfig
```kconfig
CONFIG_ARM=y
CONFIG_ARCH_AXERA=y
CONFIG_SYS_TEXT_BASE=0x14001000
CONFIG_ENV_SIZE=0x20000
CONFIG_ENV_OFFSET=0x300000
CONFIG_AXERA_AX650=y
CONFIG_TARGET_AX650_EMMC=y
CONFIG_AXERA_MEMORY_DUMP_SD=y
CONFIG_AXERA_MEMORY_DUMP_USB_STORAGE=y
CONFIG_AXERA_MEMORY_DUMP_EMMC=y
# CONFIG_PSCI_RESET is not set
CONFIG_FIT=y
CONFIG_CMD_GPIO=y
CONFIG_DM_GPIO=y
CONFIG_DWAPB_GPIO=y
# CONFIG_ARCH_FIXUP_FDT_MEMORY is not set
# CONFIG_DISPLAY_CPUINFO is not set
CONFIG_BOARD_EARLY_INIT_F=y
CONFIG_SYS_PROMPT="AXERA-UBOOT=>"
CONFIG_CMD_BOOTZ=y
CONFIG_CMD_AXERA_DOWNLOAD=y
CONFIG_CMD_AXERA_BOOT=y
CONFIG_AXERA_SECURE_BOOT=y
CONFIG_CMD_AXERA_SDUPDATE=y
CONFIG_CMD_AXERA_SDBOOT=y
CONFIG_CMD_AXERA_CIPHER=y
CONFIG_CMD_AXERA_TFTP_OTA=y
CONFIG_CMD_AXERA_USB_STOR_UPDATE=y
# CONFIG_CMD_UNZIP is not set
CONFIG_CMD_BIND=y
CONFIG_CMD_DM=y
CONFIG_CMD_GPT=y
CONFIG_CMD_MTD=y
CONFIG_CMD_NAND=y
CONFIG_CMD_NAND_TRIMFFS=y
CONFIG_CMD_NAND_YAFFS=y
CONFIG_CMD_NAND_LOCK_UNLOCK=y
CONFIG_CMD_NAND_TORTURE=y
# CONFIG_CMD_SETEXPR is not set
CONFIG_CMD_DHCP=y
CONFIG_CMD_TFTPPUT=y
CONFIG_CMD_MII=y
CONFIG_CMD_PING=y
CONFIG_CMD_TIME=y
CONFIG_CMD_FAT=y
CONFIG_CMD_EXT4=y
CONFIG_CMD_EXT4_WRITE=y
CONFIG_FS_EXT4=y
CONFIG_EXT4_WRITE=y
CONFIG_CMD_FS_GENERIC=y
CONFIG_CMD_MTDPARTS=y
CONFIG_CMD_MTDPARTS_SPREAD=y
CONFIG_CMD_MTDPARTS_SHOW_NET_SIZES=y
CONFIG_DEFAULT_DEVICE_TREE="AX650_emmc"
# CONFIG_ENV_IS_IN_NAND is not set
CONFIG_ENV_IS_IN_MMC=y
CONFIG_CMD_ERASEENV=y
CONFIG_CMD_CACHE=y
CONFIG_NET_RANDOM_ETHADDR=y
CONFIG_REGMAP=y
CONFIG_SYSCON=y
CONFIG_CLK=y
CONFIG_AXERA_DMA=y
CONFIG_DM_MMC=y
CONFIG_MMC_SDHCI_ADMA=y
CONFIG_MMC_SDHCI_AX650=y
CONFIG_CMD_AXERA_EMMC_SCAN=y
CONFIG_MTD=y
CONFIG_DM_MTD=y
CONFIG_MTD_RAW_NAND=y
CONFIG_SYS_NAND_USE_FLASH_BBT=y
CONFIG_MTD_SPI_NAND=y
CONFIG_DM_SPI_FLASH=y
CONFIG_SF_DEFAULT_CS=1
CONFIG_SPI_FLASH_GIGADEVICE=y
CONFIG_SPI_FLASH_MACRONIX=y
CONFIG_SPI_FLASH_WINBOND=y
CONFIG_SPI_FLASH_MTD=y
CONFIG_PHY_MARVELL=y
CONFIG_PHY_REALTEK=y
CONFIG_DM_ETH=y
CONFIG_AXERA_EMAC=y
# CONFIG_AXERA_EMAC_HAPS is not set
CONFIG_MII=y
CONFIG_NETDEVICES=y
CONFIG_PINCTRL=y
CONFIG_DM_PWM=y
CONFIG_PWM_AXERA=y
CONFIG_BAUDRATE=115200
CONFIG_CONS_INDEX=1
CONFIG_SYS_NS16550=y
CONFIG_SPI=y
CONFIG_DM_SPI=y
CONFIG_AXERA_SPI=y
CONFIG_SYSRESET=y
CONFIG_FS_FAT=y
CONFIG_FAT_WRITE=y
CONFIG_ERRNO_STR=y
### below for ubifs###
CONFIG_CMD_UBI=y
CONFIG_CMD_UBIFS=y
CONFIG_MTD_UBI=y
CONFIG_MTD_UBI_WL_THRESHOLD=4096
CONFIG_MTD_UBI_BEB_LIMIT=20
CONFIG_RBTREE=y
CONFIG_LZO=y
CONFIG_POSITION_INDEPENDENT=y
CONFIG_DM_I2C=y
CONFIG_DM=y
CONFIG_CMD_I2C=y
CONFIG_SYS_I2C_DW=y
###above for ubifs###
# CONFIG_AXERA_ENV_BOARD_ID is not set
CONFIG_ARMV8_SWITCH_TO_EL1=y
### below for boot logo###
CONFIG_DM_VIDEO=y
CONFIG_DISPLAY=y
CONFIG_VIDEO_MIPI_DSI=y
CONFIG_VIDEO_AXERA=y
### above for boot logo ###
# adc #
CONFIG_CMD_ADC=y
CONFIG_ADC=y
CONFIG_ADC_AXERA=y

# gpio #
CONFIG_AXERA_GPIO=y
CONFIG_GPIO=y

# pcie #
CONFIG_PCI_ENDPOINT=y
CONFIG_PCIE_AX650_BOOT=y
CONFIG_PCIE_AXERA_EP=y

# ddr #
CONFIG_AX650_DRAM=y
CONFIG_AHCI=y
CONFIG_SATA=y
CONFIG_CMD_SATA=y
CONFIG_DWC_AHSATA_AXERA=y

# USB #
CONFIG_USB=y
CONFIG_DM_USB=y
CONFIG_USB_HOST=y
CONFIG_USB_XHCI_HCD=y
CONFIG_USB_XHCI_DWC3=y
CONFIG_USB_DWC3=y
CONFIG_USB_DWC3_AXERA=y
CONFIG_USB_STORAGE=y
CONFIG_CMD_USB=y

# FIREWALL #
CONFIG_AXERA_MEMORY_FIREWALL=y
```

## boot/uboot/u-boot-2020.04/configs/AX650_xpilot_6v_defconfig
```kconfig
CONFIG_ARM=y
CONFIG_POSITION_INDEPENDENT=y
CONFIG_ARCH_AXERA=y
CONFIG_SYS_TEXT_BASE=0x14001000
CONFIG_ENV_SIZE=0x20000
CONFIG_ENV_OFFSET=0x300000
CONFIG_DM_GPIO=y
CONFIG_AXERA_AX650=y
CONFIG_TARGET_AX650_XPILOT_6V=y
CONFIG_AXERA_MEMORY_FIREWALL=y
# CONFIG_PSCI_RESET is not set
CONFIG_ARMV8_SWITCH_TO_EL1=y
CONFIG_AHCI=y
CONFIG_FIT=y
# CONFIG_ARCH_FIXUP_FDT_MEMORY is not set
# CONFIG_DISPLAY_CPUINFO is not set
CONFIG_BOARD_EARLY_INIT_F=y
CONFIG_SYS_PROMPT="AXERA-UBOOT=>"
CONFIG_CMD_BOOTZ=y
CONFIG_CMD_ERASEENV=y
CONFIG_CMD_AXERA_TFTP_OTA=y
CONFIG_CMD_AXERA_USB_STOR_UPDATE=y
# CONFIG_CMD_UNZIP is not set
CONFIG_CMD_ADC=y
CONFIG_CMD_BIND=y
CONFIG_CMD_DM=y
CONFIG_CMD_GPIO=y
CONFIG_CMD_GPT=y
CONFIG_CMD_I2C=y
CONFIG_CMD_MTD=y
CONFIG_CMD_NAND=y
CONFIG_CMD_NAND_TRIMFFS=y
CONFIG_CMD_NAND_YAFFS=y
CONFIG_CMD_NAND_LOCK_UNLOCK=y
CONFIG_CMD_NAND_TORTURE=y
CONFIG_CMD_SATA=y
CONFIG_CMD_USB=y
# CONFIG_CMD_SETEXPR is not set
CONFIG_CMD_DHCP=y
CONFIG_CMD_TFTPPUT=y
CONFIG_CMD_MII=y
CONFIG_CMD_PING=y
CONFIG_CMD_CACHE=y
CONFIG_CMD_TIME=y
CONFIG_CMD_EXT4=y
CONFIG_CMD_EXT4_WRITE=y
CONFIG_CMD_FAT=y
CONFIG_CMD_FS_GENERIC=y
CONFIG_CMD_MTDPARTS=y
CONFIG_CMD_MTDPARTS_SPREAD=y
CONFIG_CMD_MTDPARTS_SHOW_NET_SIZES=y
CONFIG_CMD_UBI=y
CONFIG_DEFAULT_DEVICE_TREE="AX650_xpilot_6v"
CONFIG_ENV_IS_IN_MMC=y
CONFIG_NET_RANDOM_ETHADDR=y
CONFIG_REGMAP=y
CONFIG_SYSCON=y
CONFIG_ADC_AXERA=y
CONFIG_DWC_AHSATA_AXERA=y
CONFIG_CLK=y
CONFIG_AX650_DRAM=y
CONFIG_AXERA_DMA=y
CONFIG_DWAPB_GPIO=y
CONFIG_AXERA_GPIO=y
CONFIG_DM_I2C=y
CONFIG_SYS_I2C_DW=y
CONFIG_DM_MMC=y
CONFIG_MMC_SDHCI_ADMA=y
CONFIG_MMC_SDHCI_AX650=y
CONFIG_MTD=y
CONFIG_DM_MTD=y
CONFIG_MTD_RAW_NAND=y
CONFIG_SYS_NAND_USE_FLASH_BBT=y
CONFIG_MTD_SPI_NAND=y
CONFIG_DM_SPI_FLASH=y
CONFIG_SF_DEFAULT_CS=1
CONFIG_SPI_FLASH_GIGADEVICE=y
CONFIG_SPI_FLASH_MACRONIX=y
CONFIG_SPI_FLASH_WINBOND=y
CONFIG_SPI_FLASH_MTD=y
CONFIG_PHY_MARVELL=y
CONFIG_PHY_REALTEK=y
CONFIG_PHY_FIXED=y
CONFIG_DM_ETH=y
CONFIG_DM_MDIO=y
CONFIG_DM_DSA=y
CONFIG_RTL9068=y
CONFIG_AXERA_EMAC=y
CONFIG_MII=y
CONFIG_PCI_ENDPOINT=y
CONFIG_PCIE_AX650_BOOT=y
CONFIG_PCIE_AXERA_EP=y
CONFIG_PINCTRL=y
CONFIG_DM_PWM=y
CONFIG_PWM_AXERA=y
CONFIG_BAUDRATE=115200
CONFIG_SYS_NS16550=y
CONFIG_SPI=y
CONFIG_DM_SPI=y
CONFIG_AXERA_SPI=y
CONFIG_SYSRESET=y
CONFIG_USB=y
CONFIG_DM_USB=y
CONFIG_USB_XHCI_HCD=y
CONFIG_USB_XHCI_DWC3=y
CONFIG_USB_DWC3=y
CONFIG_USB_DWC3_AXERA=y
CONFIG_USB_STORAGE=y
CONFIG_DM_VIDEO=y
CONFIG_DISPLAY=y
CONFIG_VIDEO_MIPI_DSI=y
CONFIG_VIDEO_AXERA=y
CONFIG_FAT_WRITE=y
CONFIG_ERRNO_STR=y
CONFIG_AXERA_SUPPORT_AB_OTA=y
CONFIG_BOOTCOUNT_LIMIT=y
CONFIG_BOOTCOUNT_ENV=y
CONFIG_HUSH_PARSER=y
CONFIG_CMD_ECHO=y
```

## boot/uboot/u-boot-2020.04/drivers/ddr/axera/Kconfig
```kconfig
menu "AX650 DDR controllers"
	depends on AXERA_AX650

config AX650_DRAM
	bool "AX650 DRAM support"
	help
	  Select the AX650 LPDDR4X driver support on AX650 SOC.
endmenu
```

## boot/uboot/u-boot-2020.04/drivers/pci_endpoint/Kconfig
```kconfig
# SPDX-License-Identifier: GPL-2.0
#
# PCI Endpoint Support
#

menu "PCI Endpoint"

config PCI_ENDPOINT
	bool "PCI Endpoint Support"
	depends on DM
	help
	   Enable this configuration option to support configurable PCI
	   endpoints. This should be enabled if the platform has a PCI
	   controllers that can operate in endpoint mode (as a device
	   connected to PCI host or bridge).

config PCIE_CADENCE_EP
	bool "Cadence PCIe endpoint controller"
	depends on PCI_ENDPOINT
	help
	  Say Y here if you want to support the Cadence PCIe controller in
	  endpoint mode. This PCIe controller may be embedded into many
	  different vendors SoCs.

config PCI_SANDBOX_EP
	bool "Sandbox PCIe endpoint controller"
	depends on PCI_ENDPOINT
	help
	  Say Y here if you want to support the Sandbox PCIe controller in
	  endpoint mode.
	  The sandbox driver act as a dummy driver which stores and
	  retrieves PCIe endpoint configuration as is.

config PCIE_AX650_BOOT
	bool "AX650 PCIe Gen2 controller"
	depends on PCI_ENDPOINT
	help
	  Say Y here if you want to enable Gen2 PCIe controller,
	  which could be found on axera SoC family.

config PCIE_AXERA_EP
	bool "AX650 PCIe Gen2 controller"
	depends on PCI_ENDPOINT
	help
	  Say Y here if you want to enable Gen2 PCIe controller,
	  which could be found on axera SoC family.

endmenu
```
