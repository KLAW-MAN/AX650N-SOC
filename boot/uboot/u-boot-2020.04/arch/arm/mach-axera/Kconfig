## boot/uboot/u-boot-2020.04/drivers/video/axera/Kconfig
```kconfig
menuconfig VIDEO_AXERA
	bool "Enable AXERA Video Support"
	depends on DM_VIDEO
	help
	  AXERA SoCs provide video output capabilities for High-Definition
	  Multimedia Interface (HDMI), Low-voltage Differential Signalling
	  (LVDS), embedded DisplayPort (eDP) and Display Serial Interface (DSI).

	  This driver supports the on-chip video output device, and targets AXERA.

config VIDEO_AXERA_MAX_XRES
        int "Maximum horizontal resolution (for memory allocation purposes)"
	depends on VIDEO_AXERA
	default 1920
	help
	  The maximum horizontal resolution to support for the framebuffer.
	  This configuration is used for reserving/allocating memory for the
	  framebuffer during device-model binding/probing.

config VIDEO_AXERA_MAX_YRES
        int "Maximum vertical resolution (for memory allocation purposes)"
	depends on VIDEO_AXERA
	default 1080
	help
	  The maximum vertical resolution to support for the framebuffer.
	  This configuration is used for reserving/allocating memory for the
	  framebuffer during device-model binding/probing.

if VIDEO_AXERA

config DISPLAY_AXERA_HDMI
	bool "HDMI port"
	depends on VIDEO_AXERA
	help
	  This enables High-Definition Multimedia Interface display support.

config DISPLAY_AXERA_MIPI
	bool "MIPI Port"
	depends on VIDEO_AXERA
	help
	  This enables Mobile Industry Processor Interface(MIPI) display
	  support.

endif
```

## kernel/linux/linux-5.15.73/crypto/async_tx/Kconfig
```kconfig
# SPDX-License-Identifier: GPL-2.0
config ASYNC_CORE
	tristate

config AXERA_ASYNC_TX_DMA
	tristate
	depends on ASYNC_TX_ENABLE_CHANNEL_SWITCH && !ASYNC_TX_DMA

config ASYNC_MEMCPY
	tristate
	select ASYNC_CORE

config ASYNC_XOR
	tristate
	select ASYNC_CORE
	select XOR_BLOCKS

config ASYNC_PQ
	tristate
	select ASYNC_CORE

config ASYNC_RAID6_RECOV
	tristate
	select ASYNC_CORE
	select ASYNC_PQ
	select ASYNC_XOR

config ASYNC_TX_DISABLE_PQ_VAL_DMA
	bool

config ASYNC_TX_DISABLE_XOR_VAL_DMA
	bool
```

## kernel/linux/linux-5.15.73/drivers/clk/axera/Kconfig
```kconfig
config COMMON_CLK_AXERA
	bool
	help
	  Axera SoCs' clock support.

config COMMON_CLK_AX650X
	bool "Clock driver for Axera AX650X"
	depends on ARCH_AXERA || COMPILE_TEST
	select COMMON_CLK_AXERA
	default ARCH_AXERA
	help
	  This driver supports Axera AX650X basic clocks.
```

## kernel/linux/linux-5.15.73/drivers/gpu/drm/axera/Kconfig
```kconfig
config DRM_AXERA
	tristate "DRM Support for Axera Display Controller"
	depends on DRM && OF && (ARM || ARM64)
	select DRM_KMS_HELPER
	select DRM_KMS_CMA_HELPER
	select DRM_GEM_CMA_HELPER
	select DRM_PANEL
	select VIDEOMODE_HELPERS
	select DRM_MIPI_DSI
	select DRM_DW_MIPI_DSI
	select DRM_PANEL_SIMPLE_AXERA

config DRM_AXERA_HDMI
	tristate "Axera hdmi controller support"
	depends on DRM_AXERA
	default n
	select DRM_AXERA_DW_HDMI
	help
	  Choose this option to enable axera dw hdmi controller driver.

source "drivers/gpu/drm/axera/synopsys_hdmi/Kconfig"
```

## kernel/linux/linux-5.15.73/drivers/pinctrl/axera/Kconfig
```kconfig
config PINCTRL_AXERA
	bool "AXERA pinctrl driver"
	depends on GPIOLIB
	select PINMUX
	select GENERIC_PINCONF
	select GENERIC_PINCTRL_GROUPS
	select GENERIC_PINMUX_FUNCTIONS
	help
	  Say Y here to enable the axera pinctrl driver

config PINCTRL_AX650X
	bool "AX650 pinctrl driver"
	depends on PINCTRL_AXERA
	help
	  Say Y here to enable the ax650 pinctrl driver
```

## kernel/linux/linux-5.15.73/drivers/reset/axera_reset/Kconfig
```kconfig
config AXERA_RESET_AX650
	tristate "AX650 Reset Driver"
	depends on HAS_IOMEM
	select MFD_SYSCON
	help
	  Build the AX650  reset driver.
```

## kernel/linux/linux-5.15.73/drivers/soc/axera/Kconfig
```kconfig
config  AX_FBCDC
	tristate "SOC FBCDC Driver"
	help
		This enable fbcdc driver.

config  AX_DMAXOR
	tristate "AX DMAXOR Driver"
	help
		This enable DMAXOR api driver.

config  AX_DMADIM
	tristate "AX DMA Driver"
	help
		This enable DMADIM driver.

config  AX_HWINFO
	tristate "AX HWINFO Driver"
	help
		This enable HWINFO driver.

config  AX_BWLIMITER
	tristate "AX BW Limiter Driver"
	help
		This enable BW Limiter driver.

config AXERA_OS_MEM
	tristate "axera os memory"
	default y

config  AX_MEMORY_DUMP
	tristate "AX MEMORY DUMP"
	select CRASH_CORE
	default y
	help
		This enable  AXERA_MEMORY_DUMP.

config  AX_SYS_MAP
	tristate "AXERA_SYS_MAP"
	default y
	help
		Driver for map the ddr space at the user space.
		Map support cached type and uncached type memory map.

config AX_OSAL
	tristate "AX OSAL API"
	default y
	help
	To use the axera platform, you need to enable this option to support the axera module Driver

config AX_HRTIMER
	tristate "AX HRTIMER"
	default y

config AX_DW_APB_TIMER
	tristate "AX APB TIMER"
 	default m

config AX_MODULE_INIT_INDEPENDENT
	bool "Axera module init independent"
	default y
```

## kernel/linux/linux-5.15.73/scripts/axera/AX650_docker_defconfig
```kconfig
# axera docker kernel configs

CONFIG_CGROUP_FREEZER=y
CONFIG_CGROUP_BPF=y
CONFIG_NETFILTER=y
CONFIG_BRIDGE_NETFILTER=y
CONFIG_NF_CONNTRACK=y
CONFIG_NF_TABLES=y
CONFIG_NETFILTER_XT_TARGET_MARK=y
CONFIG_NETFILTER_XT_MATCH_ADDRTYPE=y
CONFIG_NETFILTER_XT_MATCH_CONNTRACK=y
CONFIG_NETFILTER_XT_MATCH_IPVS=y
CONFIG_NETFILTER_XT_MATCH_MARK=y
CONFIG_IP_VS=y
CONFIG_IP_NF_IPTABLES=y
CONFIG_IP_NF_FILTER=y
CONFIG_IP_NF_NAT=y
CONFIG_IP_NF_TARGET_MASQUERADE=y
CONFIG_BRIDGE=y
CONFIG_AF_KCM=y
CONFIG_VETH=y
CONFIG_OVERLAY_FS=y
```
